## app/Kconfig
```kconfig
menuconfig LED_SUBSYSTEM
	bool "LED Subsystem"
	default y

if LED_SUBSYSTEM

config APP_HEARTBEAT_PERIOD_MS
	int "Heartbeat period (ms)"
	range 100 2000
	default 500

choice
	prompt "LED blink sleep time"
	default BLINK_SLEEP_TIME_1000MS

config BLINK_SLEEP_TIME_250MS
	bool "250ms (very fast)"

config BLINK_SLEEP_TIME_500MS
	bool "500ms (fast)"

config BLINK_SLEEP_TIME_1000MS
	bool "1s (medium)"

config BLINK_SLEEP_TIME_2000MS
	bool "2s (slow)"

endchoice

config BLINK_SLEEP_TIME_MS
	int
	default 250 if BLINK_SLEEP_TIME_250MS
	default 500 if BLINK_SLEEP_TIME_500MS
	default 1000 if BLINK_SLEEP_TIME_1000MS
	default 2000 if BLINK_SLEEP_TIME_2000MS

menuconfig LED_ADVANCED_SETTINGS
	bool "Advanced LED settings"

config LED_BRIGHTNESS
	int "LED brightness (0-100)"
	depends on LED_ADVANCED_SETTINGS
	range 0 100
	default 100

config LED_FADE_DURATION_MS
	int "LED fade duration (ms)"
	depends on LED_ADVANCED_SETTINGS
	range 0 5000
	default 500

menu "Expert settings"
	depends on LED_ADVANCED_SETTINGS
	visible if LED_ADVANCED_SETTINGS

config LED_DEBUGGING
	bool "Enable LED debugging"

config LED_CUSTOM_BLINK_PATTERN
	bool "Custom blink pattern"

endmenu

endif # LED_SUBSYSTEM

source "Kconfig.zephyr"
```
